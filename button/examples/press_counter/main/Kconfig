## button/examples/press_counter/main/Kconfig
```kconfig
# SPDX-FileCopyrightText: 2025 Salvatore Mesoraca <s.mesoraca16@gmail.com>
# SPDX-License-Identifier: Apache-2.0

menu "Button press counter example"

    config PRESS_COUNTER_GPIO
        int "Button GPIO number"
        default 0
        help
            GPIO number connected to the button.

    config PRESS_COUNTER_ACTIVE_LOW
        bool "Button is active-low"
        default y
        help
            Enable when the button reads low when pressed (the usual wiring
            with a pull-up resistor).

    config PRESS_COUNTER_LONG_PRESS_MS
        int "Long-press threshold (ms)"
        default 1000
        help
            How long the button must be held for the press to count as a
            long press.

endmenu
```

## cpptaskcreate/Kconfig
```kconfig
menu "cpptaskcreate"

    config CPPTASKCREATE_TLS_INDEX
        int "Thread local storage pointer index of the task callable"
        range 1 15
        default 1
        help
            FreeRTOS thread local storage pointer index at which
            cppTaskCreate() registers each task's callable, so that FreeRTOS
            can free it when the task is deleted. Index 0 is reserved by
            ESP-IDF for the pthreads API (the C++ exception machinery reads
            it), so it cannot be used. Raise this value if index 1 is already
            taken by another component: two components that share an index
            silently overwrite each other's pointer and deletion callback.
            The value must stay below
            CONFIG_FREERTOS_THREAD_LOCAL_STORAGE_POINTERS.

endmenu
```

## es7210/examples/record_audio/main/Kconfig
```kconfig
# SPDX-FileCopyrightText: 2025 Salvatore Mesoraca <s.mesoraca16@gmail.com>
# SPDX-License-Identifier: Apache-2.0

menu "ES7210 record audio example"

    config RECORD_AUDIO_I2C_SDA_GPIO
        int "I2C SDA GPIO number"
        default 11
        help
            GPIO number connected to the ES7210 I2C SDA line.

    config RECORD_AUDIO_I2C_SCL_GPIO
        int "I2C SCL GPIO number"
        default 10
        help
            GPIO number connected to the ES7210 I2C SCL line.

    config RECORD_AUDIO_I2C_ADDR
        int "ES7210 I2C address"
        default 64
        range 64 67
        help
            I2C address of the ES7210 (0x40 = 64 to 0x43 = 67).

    config RECORD_AUDIO_I2C_CLK_SPEED
        int "I2C clock speed (Hz)"
        default 100000
        help
            I2C SCL clock speed in Hz used to talk to the ES7210.

    config RECORD_AUDIO_I2S_MCLK_GPIO
        int "I2S MCLK GPIO number"
        default 12
        help
            GPIO number for the I2S master clock (MCLK).

    config RECORD_AUDIO_I2S_BCLK_GPIO
        int "I2S BCLK GPIO number"
        default 13
        help
            GPIO number for the I2S bit clock (BCLK).

    config RECORD_AUDIO_I2S_WS_GPIO
        int "I2S WS GPIO number"
        default 14
        help
            GPIO number for the I2S word select (WS / LRCK).

    config RECORD_AUDIO_I2S_DIN_GPIO
        int "I2S data in GPIO number"
        default 15
        help
            GPIO number for the I2S data input (ADC data).

    choice RECORD_AUDIO_BITS
        prompt "I2S bits per sample"
        default RECORD_AUDIO_BITS_16

        config RECORD_AUDIO_BITS_16
            bool "16 bit"

        config RECORD_AUDIO_BITS_32
            bool "32 bit"
    endchoice

    choice RECORD_AUDIO_MCLK_MULTIPLE
        prompt "MCLK multiple"
        default RECORD_AUDIO_MCLK_MULTIPLE_256

        config RECORD_AUDIO_MCLK_MULTIPLE_256
            bool "256"

        config RECORD_AUDIO_MCLK_MULTIPLE_384
            bool "384"

        config RECORD_AUDIO_MCLK_MULTIPLE_512
            bool "512"

        config RECORD_AUDIO_MCLK_MULTIPLE_768
            bool "768"

        config RECORD_AUDIO_MCLK_MULTIPLE_1024
            bool "1024"
    endchoice

    config RECORD_AUDIO_SAMPLE_RATE
        int "Sample rate (Hz)"
        default 16000
        help
            Sample rate in Hz. The ES7210 driver supports a fixed set of
            rates; unsupported combinations will fail at runtime.

    config RECORD_AUDIO_RECORD_SECONDS
        int "Recording duration (s)"
        default 5
        help
            How many seconds of audio are recorded before the example prints
            a summary and stops.

    config RECORD_AUDIO_MIC_MASK
        hex "Selected microphones (bitmask of MIC1..MIC4)"
        default 0x3
        help
            Bitmask of the microphones to enable (0x1 = MIC1, 0x2 = MIC2,
            0x4 = MIC3, 0x8 = MIC4). The example configures the I2S channel
            in stereo mode, so it fits two microphones; with three or more
            microphones the driver switches the ES7210 to TDM mode, which
            requires a matching TDM I2S configuration.

endmenu
```

## es8311/examples/single_tune/main/Kconfig
```kconfig
# SPDX-FileCopyrightText: 2025 Salvatore Mesoraca <s.mesoraca16@gmail.com>
# SPDX-License-Identifier: Apache-2.0

menu "ES8311 single tune example"

    config SINGLE_TUNE_I2C_SDA_GPIO
        int "I2C SDA GPIO number"
        default 11
        help
            GPIO number connected to the ES8311 I2C SDA line.

    config SINGLE_TUNE_I2C_SCL_GPIO
        int "I2C SCL GPIO number"
        default 10
        help
            GPIO number connected to the ES8311 I2C SCL line.

    config SINGLE_TUNE_I2C_ADDR
        int "ES8311 I2C address"
        default 24
        range 24 25
        help
            I2C address of the ES8311 (0x18 = 24 or 0x19 = 25).

    config SINGLE_TUNE_I2C_CLK_SPEED
        int "I2C clock speed (Hz)"
        default 100000
        help
            I2C SCL clock speed in Hz used to talk to the ES8311.

    config SINGLE_TUNE_I2S_MCLK_GPIO
        int "I2S MCLK GPIO number"
        default 12
        help
            GPIO number for the I2S master clock (MCLK).

    config SINGLE_TUNE_I2S_BCLK_GPIO
        int "I2S BCLK GPIO number"
        default 13
        help
            GPIO number for the I2S bit clock (BCLK).

    config SINGLE_TUNE_I2S_WS_GPIO
        int "I2S WS GPIO number"
        default 14
        help
            GPIO number for the I2S word select (WS / LRCK).

    config SINGLE_TUNE_I2S_DOUT_GPIO
        int "I2S data out GPIO number"
        default 16
        help
            GPIO number for the I2S data output (DAC data).

    choice SINGLE_TUNE_BITS
        prompt "I2S bits per sample"
        default SINGLE_TUNE_BITS_16

        config SINGLE_TUNE_BITS_16
            bool "16 bit"

        config SINGLE_TUNE_BITS_32
            bool "32 bit"
    endchoice

    choice SINGLE_TUNE_MCLK_MULTIPLE
        prompt "MCLK multiple"
        default SINGLE_TUNE_MCLK_MULTIPLE_512

        config SINGLE_TUNE_MCLK_MULTIPLE_256
            bool "256"

        config SINGLE_TUNE_MCLK_MULTIPLE_384
            bool "384"

        config SINGLE_TUNE_MCLK_MULTIPLE_512
            bool "512"

        config SINGLE_TUNE_MCLK_MULTIPLE_768
            bool "768"

        config SINGLE_TUNE_MCLK_MULTIPLE_1024
            bool "1024"
    endchoice

    config SINGLE_TUNE_SAMPLE_RATE
        int "Sample rate (Hz)"
        default 16000
        help
            Sample rate in Hz. The ES8311 driver supports a fixed set of
            rates; unsupported combinations will fail at runtime.

    config SINGLE_TUNE_PLAY_SECONDS
        int "Playback duration (s)"
        default 10
        help
            How long the tune is played before the example stops.

endmenu
```

## leds_effects/examples/effects_show/main/Kconfig
```kconfig
# SPDX-FileCopyrightText: 2025 Salvatore Mesoraca <s.mesoraca16@gmail.com>
# SPDX-License-Identifier: Apache-2.0

menu "LEDS effects example"

    config EFFECTS_SHOW_NUM_LEDS
        int "Number of LEDs in the strip"
        default 7
        help
            Number of LEDs the simulated strip has.

    config EFFECTS_SHOW_INTERVAL_MS
        int "Step interval (ms)"
        default 100
        help
            How long each rotating/bouncing step is shown.

    config EFFECTS_SHOW_TRANSITION_MS
        int "Transition duration (ms)"
        default 1000
        help
            Duration of the smooth_transition, sun_effect, breathing and
            deep_color effects.

    config EFFECTS_SHOW_GAP_MS
        int "Gap between effects (ms)"
        default 500
        help
            Pause between two consecutive effects.

endmenu
```

## mic_utils/examples/detect_silence/main/Kconfig
```kconfig
# SPDX-FileCopyrightText: 2025 Salvatore Mesoraca <s.mesoraca16@gmail.com>
# SPDX-License-Identifier: Apache-2.0

menu "mic_utils detect_silence example"

    config DETECT_SILENCE_SAMPLE_RATE
        int "Sample rate (Hz)"
        default 16000
        help
            Sample rate of the generated audio.

    config DETECT_SILENCE_SECONDS
        int "Silence duration (s)"
        default 2
        help
            Duration of the silent tail and of the detection window.

    config DETECT_SILENCE_THRESHOLD
        string "Silence threshold"
        default "0.001"
        help
            Maximum normalized RMS level considered silent. Entered as a
            string because Kconfig has no floating-point type.

endmenu
```

## pcf85063a/examples/rtc_datetime/main/Kconfig
```kconfig
# SPDX-FileCopyrightText: 2025 Salvatore Mesoraca <s.mesoraca16@gmail.com>
# SPDX-License-Identifier: Apache-2.0

menu "PCF85063A RTC datetime example"

    config RTC_DATETIME_I2C_SDA_GPIO
        int "I2C SDA GPIO number"
        default 11
        help
            GPIO number connected to the PCF85063A I2C SDA line.

    config RTC_DATETIME_I2C_SCL_GPIO
        int "I2C SCL GPIO number"
        default 10
        help
            GPIO number connected to the PCF85063A I2C SCL line.

    config RTC_DATETIME_I2C_CLK_SPEED
        int "I2C clock speed (Hz)"
        default 100000
        help
            I2C SCL clock speed in Hz used to talk to the PCF85063A.

    config RTC_DATETIME_PRINT_PERIOD_MS
        int "Print period (ms)"
        default 1000
        help
            How often the current RTC time is printed.

endmenu
```

## sound_driven/examples/audio_meter/sdkconfig.defaults
```kconfig
CONFIG_COMPILER_CXX_EXCEPTIONS=y
CONFIG_SPIRAM=y
CONFIG_SPIRAM_MODE_OCT=y
CONFIG_SPIRAM_USE_CAPS_ALLOC=y
CONFIG_SPIRAM_IGNORE_NOTFOUND=y
```

## sound_driven/examples/mic_vu_meter/main/Kconfig
```kconfig
# SPDX-FileCopyrightText: 2025 Salvatore Mesoraca <s.mesoraca16@gmail.com>
# SPDX-License-Identifier: Apache-2.0

menu "Sound driven mic VU meter example"

    config MIC_VU_METER_I2C_SDA_GPIO
        int "I2C SDA GPIO number"
        default 11
        help
            GPIO number connected to the ES7210 I2C SDA line.

    config MIC_VU_METER_I2C_SCL_GPIO
        int "I2C SCL GPIO number"
        default 10
        help
            GPIO number connected to the ES7210 I2C SCL line.

    config MIC_VU_METER_I2C_ADDR
        int "ES7210 I2C address"
        default 64
        range 64 67
        help
            I2C address of the ES7210 (0x40 = 64 to 0x43 = 67).

    config MIC_VU_METER_I2C_CLK_SPEED
        int "I2C clock speed (Hz)"
        default 100000
        help
            I2C SCL clock speed in Hz used to talk to the ES7210.

    config MIC_VU_METER_I2S_MCLK_GPIO
        int "I2S MCLK GPIO number"
        default 12
        help
            GPIO number for the I2S master clock (MCLK).

    config MIC_VU_METER_I2S_BCLK_GPIO
        int "I2S BCLK GPIO number"
        default 13
        help
            GPIO number for the I2S bit clock (BCLK).

    config MIC_VU_METER_I2S_WS_GPIO
        int "I2S WS GPIO number"
        default 14
        help
            GPIO number for the I2S word select (WS / LRCK).

    config MIC_VU_METER_I2S_DIN_GPIO
        int "I2S data in GPIO number"
        default 15
        help
            GPIO number for the I2S data input (ADC data).

    config MIC_VU_METER_I2S_MCLK_MULTIPLE
        int "I2S MCLK multiple"
        default 256
        help
            MCLK multiple used for the I2S bus. Must match the ES7210
            template parameter.

    config MIC_VU_METER_LED_GPIO
        int "WS2812 data GPIO number"
        default 38 if IDF_TARGET_ESP32S3
        default 18
        help
            GPIO number connected to the WS2812 data line.

    config MIC_VU_METER_NUM_LEDS
        int "Number of LEDs in the strip"
        default 7
        help
            Number of WS2812 LEDs connected to the data line.

endmenu
```

## tca9555/examples/gpio_blink/main/Kconfig
```kconfig
# SPDX-FileCopyrightText: 2025 Salvatore Mesoraca <s.mesoraca16@gmail.com>
# SPDX-License-Identifier: Apache-2.0

menu "TCA9555 GPIO blink example"

    config GPIO_BLINK_I2C_SDA_GPIO
        int "I2C SDA GPIO number"
        default 11
        help
            GPIO number connected to the TCA9555 I2C SDA line.

    config GPIO_BLINK_I2C_SCL_GPIO
        int "I2C SCL GPIO number"
        default 10
        help
            GPIO number connected to the TCA9555 I2C SCL line.

    config GPIO_BLINK_I2C_ADDR
        int "TCA9555 I2C address"
        default 32
        range 32 39
        help
            I2C address of the TCA9555 (0x20 = 32 to 0x27 = 39).

    config GPIO_BLINK_I2C_CLK_SPEED
        int "I2C clock speed (Hz)"
        default 100000
        help
            I2C SCL clock speed in Hz used to talk to the TCA9555.

endmenu
```

## ws2812/examples/color_cycle/main/Kconfig
```kconfig
# SPDX-FileCopyrightText: 2025 Salvatore Mesoraca <s.mesoraca16@gmail.com>
# SPDX-License-Identifier: Apache-2.0

menu "WS2812 color cycle example"

    config COLOR_CYCLE_GPIO
        int "WS2812 data GPIO number"
        default 38 if IDF_TARGET_ESP32S3
        default 18
        help
            GPIO number connected to the WS2812 data line. Defaults to
            GPIO 38 on ESP32-S3 and to GPIO 18 on other targets.

    config COLOR_CYCLE_NUM_LEDS
        int "Number of LEDs in the strip"
        default 7
        help
            Number of WS2812 LEDs connected to the data line.

    config COLOR_CYCLE_INTERVAL_MS
        int "Update interval (ms)"
        default 200
        help
            How long each color is shown before the next one.

    config COLOR_CYCLE_STEPS
        int "Number of steps per color"
        default 64
        help
            Number of brightness steps used to fade each color in and out.

endmenu
```
